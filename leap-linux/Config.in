## leap-linux/package/Config.in
```kconfig
menu "LEAP Packages"

source "$BR2_EXTERNAL_LEAP_PATH/package/leap/Config.in"

endmenu
```

## leap-linux/package/leap/Config.in
```kconfig
config BR2_PACKAGE_LEAP
    bool "Enable LEAP packaging"
    help
	  Packages and enables the LEAP application to run as a systemd
	  service.
```
